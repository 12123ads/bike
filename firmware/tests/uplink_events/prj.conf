## CMakeLists.txt
```
# 事件队列锁纪律的测试（native_sim + ztest + 假外设）。
#
# 为什么值得单测：`flush_events()` 的价值不在「事件能不能发出去」，而在
# **发送期间不持 `ev_lock`**。持锁发送在功能上完全正确 —— 事件照样发出去，
# 任何「事件到达服务端」的断言都是绿的。区别只在阻塞：`publish_retry` 含
# 最坏三分钟的重连阶梯，持锁期间
#   · LIS2DW12 驱动线程的 `on_motion → uplink_queue_event` 卡住
#     （motion.c 自己写着「阻塞期间的中断会丢」）
#   · 系统工作队列上的 `still_work` / `sense_work` / nvstore 的
#     `counter_work` 全排在后面 —— 包括 `lock.c` 的**释放脉冲**
#     `release_work`，被卡就是电磁锁持续通电（几百 mA）
# 全部停摆，而且恰在「车被撬、事件密集、网络又差」的时刻。
#
# 所以判据只能是「发送阻塞时，另一个线程还能不能入队」。
#
# 被测的是 firmware/nrf52840/src/uplink.c 的**原件**，一行没为测试改过；
# 硬件依赖（modem / gnss / battery / lock / unlock / nvstore）由 src/fakes.c
# 顶掉 —— 它们的行为由测试逐条控制。

cmake_minimum_required(VERSION 3.20.0)

find_package(Zephyr REQUIRED HINTS $ENV{ZEPHYR_BASE})
project(uplink_events C)

set(FW ${CMAKE_CURRENT_LIST_DIR}/../../nrf52840)

target_sources(app PRIVATE
    src/main.c
    src/fakes.c
    ${FW}/src/uplink.c
    ${FW}/src/proto.c
)

target_include_directories(app PRIVATE ${FW}/src)
```

## Kconfig
```
# uplink.c 需要的项目 Kconfig 符号。
#
# 真固件的定义在 firmware/nrf52840/Kconfig；这里只补齐让 uplink.c + proto.c
# 能编。值随便填 —— 但 CONFIG_EBIKE_ALLOW_REMOTE_UNLOCK 的默认必须和真固件
# 一致（n），否则 handle_cmd 的分支就不是被测的那条。

config EBIKE_DEVICE_ID
	string "设备 id"
	default "bike01"

config EBIKE_FW_VERSION
	string "固件版本"
	default "0.0.0-test"

config EBIKE_ALLOW_REMOTE_UNLOCK
	bool "允许远程开锁（契约 §6.1，默认关）"
	default n

config EBIKE_LOG_LEVEL
	int "本项目模块的日志等级"
	default 4
	range 0 4

source "Kconfig.zephyr"
```

## prj.conf
```kconfig
# uplink_events 测试的配置。
#
# 与 firmware/nrf52840/prj.conf **不共用**：这里只开 uplink.c 编译和运行
# 所需的最小集。

CONFIG_ZTEST=y
CONFIG_ASSERT=y

CONFIG_LOG=y
CONFIG_LOG_MODE_IMMEDIATE=y
CONFIG_EBIKE_LOG_LEVEL=4

# uplink.c 的依赖
CONFIG_REBOOT=y
# reset_cause_str() 用 hwinfo_get_reset_cause()
CONFIG_HWINFO=y

# proto.c 用 %.6f 拼坐标
CONFIG_CBPRINTF_FP_SUPPORT=y
# proto.c 用 base64_decode()（契约 §6.2 的 dn/secret）
CONFIG_BASE64=y

# 测试要另起一个线程去抢 ev_lock
CONFIG_MAIN_STACK_SIZE=4096
CONFIG_ZTEST_STACK_SIZE=8192
```

## src/main.c
```c
/*
 * 事件队列锁纪律的运行时测试。
 *
 * 被测的是 firmware/nrf52840/src/uplink.c 的原件。`flush_events()` 是 static，
 * 所以从公开面走进去：`uplink_queue_event()` 排事件，`uplink_cycle()` 冲刷。
 *
 * 被钉住的缺陷（2026-09-03 审计 M3）：`flush_events` 曾经**持 `ev_lock`
 * 跨网络 I/O** —— 锁内调 `publish_retry`，而它含最坏三分钟的重连阶梯。
 *
 * 为什么必须有这个测试：持锁发送在功能上完全正确，事件照样发出去，
 * 任何「事件到达」的断言都是绿的。区别只在阻塞期间谁被卡住：
 *   · LIS2DW12 驱动线程的 `on_motion → uplink_queue_event`
 *     （motion.c 自己写着「阻塞期间的中断会丢」）
 *   · 系统工作队列上的 `still_work`、`sense_work`、nvstore 的 `counter_work`
 *     —— 包括 `lock.c` 的**释放脉冲** `release_work`，被卡就是电磁锁
 *     持续通电（几百 mA）
 * 而且恰在「车被撬、事件密集、网络又差」的时刻。
 *
 * 所以判据是「发送阻塞时，另一个线程还能不能入队」，而不是「事件发出去了」。
 *
 * 第二条被钉住的（审计 M7）：`unlock_del_secret` / `unlock_wipe_secrets`
 * 的下行路径 —— 见 test_secret_del_and_wipe_reach_unlock_layer。
 */

#include "fakes.h"
#include "uplink.h"
#include "proto.h"

#include <stdio.h>
#include <string.h>

#include <zephyr/kernel.h>
#include <zephyr/ztest.h>

/* 抢锁的线程 —— 优先级比 ztest 主线程高一点，好让它在 publish 卡住的
 * 窗口里真的跑起来。 */
#define PROBE_STACK 2048
K_THREAD_STACK_DEFINE(probe_stack, PROBE_STACK);
static struct k_thread probe_thread;

/* 探针结果 */
static struct {
	int64_t queued_at_ms;     /* 入队返回的时刻 */
	int rc;
	bool done;
} probe;

static void probe_fn(void *a, void *b, void *c)
{
	ARG_UNUSED(a);
	ARG_UNUSED(b);
	ARG_UNUSED(c);

	/* 这就是 on_motion 在真设备上做的事 */
	probe.rc = uplink_queue_event(EV_MOTION, "{\"mg\":260}");
	probe.queued_at_ms = k_uptime_get();
	probe.done = true;
}

static void *setup(void)
{
	fake_reset();
	zassert_ok(uplink_init(), "uplink_init 失败");
	return NULL;
}

static void before(void *fixture)
{
	ARG_UNUSED(fixture);
	fake_reset();
	memset(&probe, 0, sizeof(probe));
	/* uplink_init 已经跑过（setup），fake_reset 把 dn_cb 清了 ——
	 * 重新注册，否则下行测试收不到东西。 */
	zassert_ok(uplink_init(), "uplink_init 失败");
}

ZTEST_SUITE(uplink_events, NULL, setup, before, NULL, NULL);

/* --- 正常路径：先证明链路真的通 --------------------------------------------- */

/* 后面的断言都是「阻塞时能不能怎样」，「一律不发」也会绿。这条防那个。 */
ZTEST(uplink_events, test_queued_event_is_published_next_cycle)
{
	zassert_ok(uplink_queue_event(EV_MOTION, "{\"mg\":260}"), "入队失败");

	zassert_ok(uplink_cycle(false), "一轮上报失败");

	bool found = false;

	for (size_t i = 0; i < fake.publish_n; i++) {
		if (strstr(fake.published[i].topic, "up/event") != NULL &&
		    strstr(fake.published[i].payload, "\"e\":\"motion\"") != NULL) {
			found = true;
			zassert_not_null(strstr(fake.published[i].payload,
						"\"mg\":260"),
					 "detail 丢了：%s",
					 fake.published[i].payload);
		}
	}
	zassert_true(found, "排队的事件没发出去（发了 %zu 条）", fake.publish_n);
}

/* 发成功的事件必须从队列里销掉，不能下一轮重发。 */
ZTEST(uplink_events, test_published_event_is_not_resent)
{
	zassert_ok(uplink_queue_event(EV_STILL, NULL), "入队失败");
	zassert_ok(uplink_cycle(false), "第一轮失败");

	size_t after_first = fake.publish_n;

	zassert_ok(uplink_cycle(false), "第二轮失败");

	for (size_t i = after_first; i < fake.publish_n; i++) {
		zassert_is_null(strstr(fake.published[i].topic, "up/event"),
				"已发成功的事件被重发了");
	}
}

/* 发失败的事件要留到下一轮 —— (dev,q) 去重让重发安全（契约 §5）。 */
ZTEST(uplink_events, test_failed_event_is_retried_next_cycle)
{
	zassert_ok(uplink_queue_event(EV_LOWBATT, "{\"lv\":1,\"v\":46.2}"),
		   "入队失败");

	fake.publish_rc = -EIO;      /* 全都发失败 */
	fake.connected = true;       /* 会话还在 —— publish_retry 不走重连 */
	(void)uplink_cycle(false);

	fake.publish_rc = 0;
	fake.publish_n = 0;
	zassert_ok(uplink_cycle(false), "第二轮失败");

	bool found = false;

	for (size_t i = 0; i < fake.publish_n; i++) {
		if (strstr(fake.published[i].payload, "\"e\":\"lowbatt\"") != NULL) {
			found = true;
		}
	}
	zassert_true(found, "发失败的事件没留到下一轮 —— 事件被丢了");
}

/* --- M3：发送期间绝不持 ev_lock ---------------------------------------------- */

/* **这条是 M3 的核心。**
 *
 * 卡住 `up/event` 的那次 publish（模拟重连阶梯），同时让另一个线程调
 * `uplink_queue_event()` —— 那正是 LIS2DW12 驱动线程在真设备上做的事。
 *
 * - 修复前：`flush_events` 持 `ev_lock` 调 publish，探针线程在
 *   `k_mutex_lock(&ev_lock)` 上睡到 publish 返回，`queued_at_ms` 落在
 *   放行之后。
 * - 修复后：锁内只做快照，探针立刻拿到锁，`queued_at_ms` 落在放行之前。
 *
 * 判据是**时刻**而不是「最终有没有入队」：持锁的实现最终也会入队，
 * 只是晚了三分钟 —— 而那三分钟里锁释放脉冲也排在后面。
 */
ZTEST(uplink_events, test_queue_event_not_blocked_by_publish_in_flight)
{
	zassert_ok(uplink_queue_event(EV_UNLOCK_DENY, "{\"uid\":7}"),
		   "预置事件失败");

	/* 卡住事件那一条 publish */
	strcpy(fake.block_publish_on_topic, "up/event");

	/* 后台跑一轮上报 —— 它会在 up/event 那条 publish 上停住 */
	static struct k_thread cycle_thread;
	static K_THREAD_STACK_DEFINE(cycle_stack, 4096);

	k_thread_create(&cycle_thread, cycle_stack, K_THREAD_STACK_SIZEOF(cycle_stack),
			(k_thread_entry_t)(void *)uplink_cycle,
			(void *)false, NULL, NULL,
			K_PRIO_PREEMPT(7), 0, K_NO_WAIT);

	/* 等它真的进到 publish 里 */
	zassert_ok(k_sem_take(&fake.publish_entered, K_SECONDS(5)),
		   "publish 没被卡住 —— 这个探针测不出 M3，别信下面的断言");

	int64_t blocked_at = k_uptime_get();

	/* 现在「网络卡着」。传感器线程要入队一条新事件。 */
	k_thread_create(&probe_thread, probe_stack, PROBE_STACK,
			probe_fn, NULL, NULL, NULL,
			K_PRIO_PREEMPT(6), 0, K_NO_WAIT);

	/* 给它 500 ms —— 真设备上 publish 会卡几十秒到三分钟，
	 * 这里只要能区分「立刻」和「等 publish 结束」就够。 */
	k_sleep(K_MSEC(500));

	bool queued_while_blocked = probe.done;
	int64_t queued_at = probe.queued_at_ms;

	/* 放 publish 走，收尾 */
	k_sem_give(&fake.publish_gate);
	(void)k_thread_join(&cycle_thread, K_SECONDS(10));
	(void)k_thread_join(&probe_thread, K_SECONDS(10));

	zassert_true(queued_while_blocked,
		     "publish 阻塞期间入队被卡住了 —— flush_events 持 ev_lock "
		     "跨网络 I/O（审计 M3）。真设备上这一卡最坏三分钟，"
		     "期间锁释放脉冲也排在后面 = 电磁锁持续通电");
	zassert_true(queued_at - blocked_at < 400,
		     "入队等了 %lld ms —— 说明它在等锁",
		     (long long)(queued_at - blocked_at));
	zassert_ok(probe.rc, "入队返回 %d", probe.rc);
}

/* 反向护栏：阻塞期间入队的那条事件不能丢，下一轮要发出去。
 * 上一条修法如果写成「锁外发送但快照期间的新事件被覆盖」，这条会红。 */
ZTEST(uplink_events, test_event_queued_during_publish_survives)
{
	zassert_ok(uplink_queue_event(EV_UNLOCK_DENY, "{\"uid\":7}"),
		   "预置事件失败");
	strcpy(fake.block_publish_on_topic, "up/event");

	static struct k_thread cycle_thread;
	static K_THREAD_STACK_DEFINE(cycle_stack, 4096);

	k_thread_create(&cycle_thread, cycle_stack, K_THREAD_STACK_SIZEOF(cycle_stack),
			(k_thread_entry_t)(void *)uplink_cycle,
			(void *)false, NULL, NULL,
			K_PRIO_PREEMPT(7), 0, K_NO_WAIT);
	zassert_ok(k_sem_take(&fake.publish_entered, K_SECONDS(5)),
		   "publish 没被卡住");

	/* 阻塞期间入队一条 boot（用一个前面没出现过的类型，好认） */
	zassert_ok(uplink_queue_event(EV_BOOT, NULL), "阻塞期间入队失败");

	k_sem_give(&fake.publish_gate);
	(void)k_thread_join(&cycle_thread, K_SECONDS(10));

	/* 下一轮必须把它发出去 */
	fake.publish_n = 0;
	zassert_ok(uplink_cycle(false), "第二轮失败");

	bool found = false;

	for (size_t i = 0; i < fake.publish_n; i++) {
		if (strstr(fake.published[i].payload, "\"e\":\"boot\"") != NULL) {
			found = true;
		}
	}
	zassert_true(found,
		     "发送期间入队的事件被丢了 —— 锁外发送把新事件的槽位清掉了");
}

/* --- M7：密钥删除/清空的下行路径 --------------------------------------------- */

/* `unlock_del_secret` / `unlock_wipe_secrets` 必须真的被 `dn/secret` 触发。
 *
 * 审计 M7 修的是那两个函数**内部**要清 `counter`（防槽位复用继承旧值把新
 * 手机锁在门外）。那一半属于 unlock.c，这里钉的是**上行下行的接线**：
 * 报文 → 正确的函数 → ack。接线断了的话 M7 的修复根本跑不到。
 *
 * （counter 清零本身由 unlock.c 的 users_lock 段保证，bsim 的 8 条断言覆盖
 * 开锁路径；「删了再加新用户不继承旧 counter」需要一个能操作 users[] 的
 * 测试应用，那是 unlock.c 自己的测试范围。）
 */
ZTEST(uplink_events, test_secret_del_and_wipe_reach_unlock_layer)
{
	zassert_not_null(fake.dn_cb, "modem_init 没拿到 dn_cb");

	const char *del = "{\"id\":\"s-1\",\"op\":\"del\",\"uid\":7}";

	fake.dn_cb("ebike/v1/bike01/dn/secret", (const uint8_t *)del,
		   strlen(del));
	zassert_equal(fake.del_secret_calls, 1, "del 没走到 unlock_del_secret");
	zassert_equal(fake.del_secret_uid, 7, "uid 传错：%u", fake.del_secret_uid);

	const char *wipe = "{\"id\":\"s-2\",\"op\":\"wipe\"}";

	fake.dn_cb("ebike/v1/bike01/dn/secret", (const uint8_t *)wipe,
		   strlen(wipe));
	zassert_equal(fake.wipe_calls, 1, "wipe 没走到 unlock_wipe_secrets");

	/* 两条都要 ack —— 服务端靠 ack 销账，不 ack 就永久重发 */
	int acks = 0;

	for (size_t i = 0; i < fake.publish_n; i++) {
		if (strstr(fake.published[i].topic, "up/ack") != NULL) {
			acks++;
			zassert_not_null(strstr(fake.published[i].payload,
						"\"ok\":1"),
					 "ack 报了失败：%s",
					 fake.published[i].payload);
		}
	}
	zassert_equal(acks, 2, "只发了 %d 条 ack", acks);
}

/* 密钥层返回失败时，ack 必须报失败 —— 报成功会让服务端销账，
 * 而设备上那把密钥其实没写进去。 */
ZTEST(uplink_events, test_secret_failure_is_acked_as_failure)
{
	fake.secret_rc = -ENOENT;

	const char *del = "{\"id\":\"s-3\",\"op\":\"del\",\"uid\":9}";

	fake.dn_cb("ebike/v1/bike01/dn/secret", (const uint8_t *)del,
		   strlen(del));

	bool saw_fail = false;

	for (size_t i = 0; i < fake.publish_n; i++) {
		if (strstr(fake.published[i].topic, "up/ack") != NULL &&
		    strstr(fake.published[i].payload, "\"ok\":0") != NULL) {
			saw_fail = true;
		}
	}
	zassert_true(saw_fail, "密钥操作失败却 ack 成功 —— 服务端会错误销账");
}
```

## src/fakes.c
```c
/*
 * uplink.c 的硬件依赖替身。
 *
 * 这些函数的**行为由测试逐条控制**（见 fakes.h 的那几个钩子），所以是
 * 「可编程的假实现」而不是空壳 —— 空壳测不出锁纪律：判据是
 * 「publish 阻塞期间另一个线程能不能入队」，那要求 publish 能被卡住。
 *
 * 只顶掉外设层。`uplink.c` 和 `proto.c` 是原件。
 */

#include "fakes.h"

#include <string.h>
#include <errno.h>

#include <zephyr/kernel.h>

/* --- 可编程状态 -------------------------------------------------------------- */

struct fake_state fake;

void fake_reset(void)
{
	memset(&fake, 0, sizeof(fake));
	fake.connected = true;
	fake.utc = 1756900000;
	fake.batt_mv = 52000;
	k_sem_init(&fake.publish_gate, 0, 1);
	k_sem_init(&fake.publish_entered, 0, 1);
}

/* --- modem ----------------------------------------------------------------- */

int modem_init(modem_dn_cb cb)
{
	fake.dn_cb = cb;
	return 0;
}

int modem_connect(void)
{
	fake.connect_calls++;
	return fake.connect_rc;
}

int modem_reconnect(void)
{
	fake.reconnect_calls++;
	return fake.reconnect_rc;
}

int modem_disconnect(void)
{
	fake.disconnect_calls++;
	return 0;
}

bool modem_is_connected(void)
{
	return fake.connected;
}

int modem_publish(const char *topic, const uint8_t *payload, size_t len,
		  int qos)
{
	ARG_UNUSED(qos);

	if (fake.publish_n < FAKE_PUBLISH_MAX) {
		strncpy(fake.published[fake.publish_n].topic, topic,
			sizeof(fake.published[0].topic) - 1);
		size_t n = len < sizeof(fake.published[0].payload) - 1
				   ? len : sizeof(fake.published[0].payload) - 1;
		memcpy(fake.published[fake.publish_n].payload, payload, n);
		fake.published[fake.publish_n].payload[n] = '\0';
		fake.published[fake.publish_n].len = len;
		fake.publish_n++;
	}

	/* 卡住这一次 publish —— 模拟 publish_retry 里那条最坏三分钟的重连阶梯。
	 * 测试用 `publish_entered` 知道「已经进来了」，用 `publish_gate` 决定
	 * 什么时候放它走。 */
	if (fake.block_publish_on_topic[0] != '\0' &&
	    strstr(topic, fake.block_publish_on_topic) != NULL) {
		fake.block_publish_on_topic[0] = '\0';   /* 只卡第一次 */
		k_sem_give(&fake.publish_entered);
		(void)k_sem_take(&fake.publish_gate, K_SECONDS(10));
	}

	return fake.publish_rc;
}

int modem_poll(uint32_t timeout_ms)
{
	ARG_UNUSED(timeout_ms);
	return 0;
}

int modem_csq(void)
{
	return 19;
}

uint32_t modem_utc(void)
{
	return fake.utc;
}

int modem_lbs(double *lat, double *lon, float *acc_m)
{
	ARG_UNUSED(lat);
	ARG_UNUSED(lon);
	ARG_UNUSED(acc_m);
	return -ENOTSUP;
}

/* --- gnss ------------------------------------------------------------------ */

int gnss_init(void)
{
	return 0;
}

int gnss_fix(struct gnss_fix *out, uint32_t timeout_s)
{
	ARG_UNUSED(timeout_s);
	memset(out, 0, sizeof(*out));
	out->heading = -1;
	out->speed_ms = -1.0f;
	return -ETIMEDOUT;
}

int gnss_power_off(void)
{
	return 0;
}

/* --- battery --------------------------------------------------------------- */

int battery_init(void)
{
	return 0;
}

int battery_read_mv(void)
{
	return fake.batt_mv;
}

int battery_low_level(int mv)
{
	ARG_UNUSED(mv);
	return 0;
}

/* --- lock ------------------------------------------------------------------ */

int lock_init(void)
{
	return 0;
}

int lock_unlock(void)
{
	fake.unlock_calls++;
	return 0;
}

int lock_lock(void)
{
	fake.lock_calls++;
	return 0;
}

bool lock_is_open(void)
{
	return false;
}

void lock_set_callback(lock_state_cb cb)
{
	ARG_UNUSED(cb);
}

/* --- unlock ---------------------------------------------------------------- */

int unlock_set_secret(uint32_t uid, const uint8_t secret[SECRET_LEN],
		      uint16_t kid)
{
	ARG_UNUSED(secret);
	fake.set_secret_uid = uid;
	fake.set_secret_kid = kid;
	fake.set_secret_calls++;
	return fake.secret_rc;
}

int unlock_del_secret(uint32_t uid)
{
	fake.del_secret_uid = uid;
	fake.del_secret_calls++;
	return fake.secret_rc;
}

int unlock_wipe_secrets(void)
{
	fake.wipe_calls++;
	return fake.secret_rc;
}

uint16_t unlock_current_kid(void)
{
	return fake.set_secret_kid;
}

/* --- nvstore --------------------------------------------------------------- */

int nvstore_init(void)
{
	return 0;
}

uint32_t nvstore_next_q(void)
{
	return ++fake.q;
}

uint32_t nvstore_boot_count(void)
{
	return 1;
}

void nvstore_queue_counter(uint32_t uid, uint32_t counter)
{
	ARG_UNUSED(uid);
	ARG_UNUSED(counter);
}

int nvstore_flush(void)
{
	return 0;
}

uint32_t nvstore_report_interval(void)
{
	return 900;
}

int nvstore_set_report_interval(uint32_t seconds)
{
	if (seconds < 60 || seconds > 86400) {
		return -EINVAL;
	}
	fake.report_interval = seconds;
	return 0;
}

/* --- motion ---------------------------------------------------------------- */

int motion_init(motion_cb cb)
{
	ARG_UNUSED(cb);
	return 0;
}

int motion_set_threshold_mg(uint16_t mg)
{
	ARG_UNUSED(mg);
	return 0;
}

void motion_note_activity(void)
{
}

enum motion_state motion_current(void)
{
	return MOTION_STILL;
}

/* --- crypto ---------------------------------------------------------------- */

void crypto_wipe(void *p, size_t len)
{
	memset(p, 0, len);
}
```

## src/fakes.h
```c
/*
 * uplink.c 的替身外设状态。测试通过这些字段控制假实现的行为，
 * 并读回「被调用了什么」。
 */

#ifndef EBIKE_TEST_FAKES_H
#define EBIKE_TEST_FAKES_H

#include "battery.h"
#include "crypto.h"
#include "gnss.h"
#include "lock.h"
#include "modem.h"
#include "motion.h"
#include "nvstore.h"
#include "unlock.h"

#include <stdbool.h>
#include <stddef.h>
#include <stdint.h>

#include <zephyr/kernel.h>

#define FAKE_PUBLISH_MAX 16

struct fake_state {
	/* --- modem 的可编程返回值 --- */
	bool connected;
	int connect_rc;
	int reconnect_rc;
	int publish_rc;
	uint32_t utc;

	int connect_calls;
	int reconnect_calls;
	int disconnect_calls;

	modem_dn_cb dn_cb;

	/* 发出去的报文（topic + payload 原文） */
	struct {
		char topic[64];
		char payload[256];
		size_t len;
	} published[FAKE_PUBLISH_MAX];
	size_t publish_n;

	/* 卡住第一次 topic 含这个子串的 publish。空串 = 不卡。
	 * 这是测锁纪律的关键：`publish_retry` 里那条最坏三分钟的重连阶梯，
	 * 在测试里就是这个门。 */
	char block_publish_on_topic[32];
	struct k_sem publish_gate;      /* 测试 give 它放 publish 走 */
	struct k_sem publish_entered;   /* publish 进门时 give，测试 take */

	/* --- 其它外设 --- */
	int batt_mv;
	int unlock_calls;
	int lock_calls;
	uint32_t q;
	uint32_t report_interval;

	int secret_rc;
	int set_secret_calls;
	int del_secret_calls;
	int wipe_calls;
	uint32_t set_secret_uid;
	uint16_t set_secret_kid;
	uint32_t del_secret_uid;
};

extern struct fake_state fake;

void fake_reset(void);

#endif /* EBIKE_TEST_FAKES_H */
```
